## src/modules/listen_and_speak/Kconfig
```kconfig
menuconfig MODULES_LISTEN_AND_SPEAK
	bool "listen_and_speak"
	default y

	help
	  Enables the listen_and_speak module, which subscribes to servo_angle
	  and publishes wrench_command & thrust_command.
```

## src/modules/torque_dob/Kconfig
```kconfig
menuconfig MODULES_TORQUE_DOB
	bool "torque_dob"
	default n
	---help---
		Enable support for torque_dob

menuconfig USER_TORQUE_DOB
	bool "torque_dob running as userspace module"
	default y
	depends on BOARD_PROTECTED && MODULES_TORQUE_DOB
	---help---
		Put torque_dob in userspace memory
```
